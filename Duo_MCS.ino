#include <Bridge.h>
#include <HttpClient.h>
#include <BridgeClient.h>

#define DEVICEID "D0PlBTHw" // Input your deviceId
#define DEVICEKEY "3Qu4RO7YYsXUbGQW" // Input your deviceKey
#define SITE_URL "api.mediatek.com"

static unsigned long beat = 0;
static String commandServer;
static int commandPort = 0;

int relay_port = 4;         // I/O

// This will be used to connect to command server
BridgeClient bc;

#include <dht.h>
#include <SeeedOLED.h>


dht DHT;
#define DHT22_PIN 9

struct
{
    uint32_t total;
    uint32_t ok;
    uint32_t crc_error;
    uint32_t time_out;
    uint32_t connect;
    uint32_t ack_l;
    uint32_t ack_h;
    uint32_t unknown;
} stat = { 0,0,0,0,0,0,0,0};


const unsigned char lamp [] PROGMEM = {
0x00, 0x00, 0x00, 0x00, 0x00, 0x00, 0x00, 0x00, 0x00, 0x00, 0x00, 0x00, 0x00, 0x00, 0x00, 0x00,
0x00, 0x00, 0x00, 0x00, 0x00, 0x00, 0x7C, 0xF0, 0x00, 0x00, 0x00, 0x00, 0x00, 0x00, 0x00, 0x00,
0x00, 0x00, 0x00, 0x00, 0x00, 0xC0, 0x70, 0x00, 0x00, 0x00, 0x00, 0x00, 0x00, 0x00, 0x00, 0x00,
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0x00, 0x00, 0x00, 0x00, 0x00, 0x00, 0x00, 0x00, 0x00, 0x00, 0x00, 0x00, 0x00, 0x00, 0x00, 0x00
};



void display_init()
{
    
  SeeedOled.init();  //initialze SEEED OLED display
  DDRB|=0x21;        
  PORTB |= 0x21;
  SeeedOled.clearDisplay();               // clear the screen and set start position to top left corner
  SeeedOled.drawBitmap(lamp,1024);
  SeeedOled.setNormalDisplay(); 
  SeeedOled.setTextXY(1,9); 
  SeeedOled.putString("Hall");
  

}
void display_oled(int value)
{ 
  SeeedOled.setTextXY(3,10); 
  SeeedOled.putString("Temp");
  SeeedOled.setTextXY(5,11);
  SeeedOled.putString("    ");
  SeeedOled.setTextXY(5,11);
  SeeedOled.putNumber(value);       
}

void setup()
{
  Bridge.begin();
  Serial.begin(115200);

 display_init();

 pinMode(relay_port, OUTPUT);
  
//  while(!Serial) delay(1000); /* comment out this line when Serial is not present, ie. run this demo without connect to PC */

  getCommandServer();
  beat = millis();
}

void getCommandServer()
{
  Serial.print("Query command server:");
  
  // Prepare header for MCS API authentication
  String header = "deviceKey: ";
  header += DEVICEKEY;
  header += "\r\n";
  header += "Connection: close";

  HttpClient c;
  c.setHeader(header);
  c.get(SITE_URL "/mcs/v2/devices/" DEVICEID "/connections.csv");
  c.setTimeout(1000);
  
  const String resp = c.readString();
  const int sep = resp.indexOf(',');
  if (-1 == sep)
  {
    Serial.println("Fail to get command server. Make sure you already configured LinkIt Smart 7688 to internet and setup DEVICEID and DEVICEKEY in the sketch.");
    Serial.flush();
    return;
  }
  commandServer = resp.substring(0, sep);
  commandPort = resp.substring(sep+1).toInt();  
  Serial.print(commandServer);
  Serial.print(":");
  Serial.println(commandPort);
  int ret = bc.connect(commandServer.c_str(), commandPort);
  Serial.print("connect result = ");
  Serial.println(ret);
  Serial.flush();
}

void heartBeat(Client &c)
{
  // Send a heart beat data;
  // format reference: https://mcs.mediatek.com/resources/latest/api_references/#get-connection
  static const char* heartbeat = DEVICEID "," DEVICEKEY ",0";
  c.println(heartbeat);
  c.println();
  Serial.println("HeartBeat sent.");
  Serial.flush();
  delay(100);
}

void loop()
{
  if(!bc.connected())
  {
    Serial.println("command server offline, try re-connect");
    int ret = bc.connect(commandServer.c_str(), commandPort);
    Serial.print("connect = ");
    Serial.println(ret);
    Serial.flush();
  }
  
  // send heart beat for every 30 seconds;
  // or our connection will be closed by command server.
  if(30000 < (millis() - beat))
  {
    heartBeat(bc);
    beat = millis();
  }

  // process commands if any
  // note that the command server will also echo our hearbeat.
  String tcpcmd;
  static const char* tcpcmd_led_on = "LED_Control,1";
  static const char* tcpcmd_led_off = "LED_Control,0";
  bool sendUpdate = false;
  while (bc.available())
  {
    int v = bc.read();
    if (v != -1)
    {
      Serial.print((char)v);
      tcpcmd += (char)v;
      if (tcpcmd.substring(40).equals(tcpcmd_led_on)){
        digitalWrite(13, HIGH);
        Serial.println("Switch LED ON ");
         digitalWrite(relay_port, HIGH);
        tcpcmd="";
        sendUpdate = true;
      }else if(tcpcmd.substring(40).equals(tcpcmd_led_off)){  
        digitalWrite(13, LOW);
        Serial.println("Switch LED OFF");
         digitalWrite(relay_port, LOW);
        tcpcmd="";
        sendUpdate = true;
      }
    }
  }


  readTemperatureFromSensor();
  readSoilMoistureData();
  
  // POST LED value back to MCS.
  if(sendUpdate)
  {
    uploadstatus();
  }
  
  delay(300);
}


 int sensorMoistureValue = 0; 

 
void uploadstatus()
{  
  // We update the LED_Display data value
  // to reflect the status of the board.

  String upload_led = "";
  
  upload_led = (digitalRead(13)==1) ? "LED_Display,,1" : "LED_Display,,0";

  upload_led +=  "\nHumidity_Id,,"+String(DHT.humidity) ;
  upload_led +=  "\nTemperature_Id,,"+String(DHT.temperature) ;
  upload_led +=  "\nMoisture_Id,,"+String(sensorMoistureValue) ;
  
  

  // Prepare HTTP header for MCS API authentication.
  // note that we don't have to add content-length and content-type.
  // these will be automatically added by HttpClient (with curl).
  // 
  // !We must put Content-Type in the first line to prevent
  // curl from sending "application/x-www-form-urlencoded" 
  // as content-type. MCS blocks "application/x-www-form-urlencoded"
  // just like many web services.
  String header = "Content-Type: text-csv\r\n";
  header += "deviceKey: ";
  header += DEVICEKEY;
  header += "\r\n";
  header += "Connection: close";

  // refer to https://mcs.mediatek.com/resources/latest/api_references/#upload-data-points
  HttpClient http;
  http.setHeader(header);
  http.post(SITE_URL "/mcs/v2/devices/" DEVICEID "/datapoints.csv", upload_led.c_str());
  http.setTimeout(1000);
  
  delay(300);

  String resp = http.readString();
  Serial.print("POST result:");
  Serial.println(resp);
}

void readSoilMoistureData()
{

  int sensorPin = A0;    // select the input pin for the potentiometer
  // sensorValue = 0;  // variable to store the value coming from the sensor
 
  // read the value from the sensor:
  sensorMoistureValue = analogRead(sensorPin);    
  //delay(1000);          
  Serial.print("Soil Msoisture = " );                       
  Serial.println(sensorMoistureValue);   
  
}



void startServoMotor()
{

  
}

void stopServoMotor()
{
  
}

void readTemperatureFromSensor()
{
    // READ DATA
    Serial.print("DHT22, \t");

    uint32_t start = micros();
    int chk = DHT.read22(DHT22_PIN);
    uint32_t stop = micros();

    stat.total++;
    switch (chk)
    {
    case DHTLIB_OK:
        stat.ok++;
        Serial.print("OK,\t");
        break;
    case DHTLIB_ERROR_CHECKSUM:
        stat.crc_error++;
        Serial.print("Checksum error,\t");
        break;
    case DHTLIB_ERROR_TIMEOUT:
        stat.time_out++;
        Serial.print("Time out error,\t");
        break;
    case DHTLIB_ERROR_CONNECT:
        stat.connect++;
        Serial.print("Connect error,\t");
        break;
    case DHTLIB_ERROR_ACK_L:
        stat.ack_l++;
        Serial.print("Ack Low error,\t");
        break;
    case DHTLIB_ERROR_ACK_H:
        stat.ack_h++;
        Serial.print("Ack High error,\t");
        break;
    default:
        stat.unknown++;
        Serial.print("Unknown error,\t");
        break;
    }
    // DISPLAY DATA
    Serial.print(DHT.humidity, 1);
    Serial.print(",\t");
    Serial.print(DHT.temperature, 1);
    display_oled(DHT.temperature);
    Serial.print(",\t");
    Serial.print(stop - start);
    Serial.println();

    if (stat.total % 20 == 0)
    {
        Serial.println("\nTOT\tOK\tCRC\tTO\tUNK");
        Serial.print(stat.total);
        Serial.print("\t");
        Serial.print(stat.ok);
        Serial.print("\t");
        Serial.print(stat.crc_error);
        Serial.print("\t");
        Serial.print(stat.time_out);
        Serial.print("\t");
        Serial.print(stat.connect);
        Serial.print("\t");
        Serial.print(stat.ack_l);
        Serial.print("\t");
        Serial.print(stat.ack_h);
        Serial.print("\t");
        Serial.print(stat.unknown);
        Serial.println("\n");
    }
   // delay(2000);
}

